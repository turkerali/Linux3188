## arch/arm/mach-rk3188/Kconfig
```kconfig
choice
	prompt "Rockchip SoC Type"
	depends on ARCH_RK3188

config SOC_RK3188
	bool "RK3188"

endchoice


choice
	prompt "RK3188 Board Type"
	depends on SOC_RK3188

config MACH_RK3188_TB
	bool "RK3188 Top Board"

config MACH_RK3188_FPGA
	bool "RK3188 FPGA board"
	select RK_FPGA

config MACH_RK3188_LR097
        bool "RK3188 LR097 JC21CA board"

config MACH_RK3188_DS1006H
	bool "RK3188 ds1006h board"

config MACH_RK3188_BOX
	bool "RK3188 box board"
	
endchoice


menu "RK3188 Custom Tweaks"
 	depends on ARCH_RK3188 && MACH_RK3188_BOX

config TCC_BT_DEV_POWER_PIN3_PD1
	bool "Set TCC BT dev pwer to pin3 pd1"
	default n

config ACT8846_DCDC4_30V
	bool "Set ACT8846 DCDC4 to 3.0V"
	default n

config ACT8846_LDO6_18V
	bool "Set ACT 8846 LDO6 to 1.8V"
	default n


config RFKILL_RK_POWERON_PIN3_PD1
  bool "Use GPIO PIN3 PD1 for RFKILL RK poweron"
  default y

config RFKILL_RK_RESET_INVALID_GPIO
  bool "Use INVALID_GPIO for RFKILL RK reset"
  default y

config RFKILL_RK_WAKE_PIN3_PC7
  bool "Use GPIO PIN3 PC7 for RFKILL RK wake"
  default y

config RFKILL_RK_WAKE_HOST_PIN3_PC6
  bool "Use GPIO PIN3 PC6 for RFKILL RK wake host"
  default y



config RK_PWM_VOLT_MAX_1450
	bool "Raise the PWM voltage limit up to 1.450V"
	help
	  This setting does not change any voltages, it merely raises the upper voltage limit from 1.375V to 1.450V for usage in overclocking


menu	"CPU Frequency Scaling"

config	RK_CPU_312
	bool "312 MHz CPU"
	default y

config	RK_CPU_312_VOLT
	depends on RK_CPU_312
	int "312 MHz CPU voltage (mV)"
	default "900"

config	RK_CPU_504
	bool "504 MHz CPU"
	default y

config	RK_CPU_504_VOLT
	depends on RK_CPU_504
	int "504 MHz CPU voltage (mV)"
	default "925"

config	RK_CPU_816
	bool "816 MHz CPU"
	default y

config	RK_CPU_816_VOLT
	depends on RK_CPU_816
	int "816 MHz CPU voltage (mV)"
	default "1000"

config	RK_CPU_1008
	bool "1008 MHz CPU"
	default y

config	RK_CPU_1008_VOLT
	depends on RK_CPU_1008
	int "1008 MHz CPU voltage (mV)"
	default "1075"

config	RK_CPU_1200
	bool "1200 MHz CPU"
	default y

config	RK_CPU_1200_VOLT
	depends on RK_CPU_1200
	int "1200 MHz CPU voltage (mV)"
	default "1150"

config	RK_CPU_1416
	bool "1416 MHz CPU"
	default y

config	RK_CPU_1416_VOLT
	depends on RK_CPU_1416
	int "1416 MHz CPU voltage (mV)"
	default "1250"

config	RK_CPU_1608
	bool "1608 MHz CPU"
	default y

config	RK_CPU_1608_VOLT
	depends on RK_CPU_1608
	int "1608 MHz CPU voltage (mV)"
	default "1350"

config	RK_CPU_1704
	bool "1704 MHz CPU (overclock!)"
	default n

config	RK_CPU_1704_VOLT
	depends on RK_CPU_1704
	int "1704 MHz CPU voltage (mV)"
	default "1375"

config	RK_CPU_1800
	bool "1800 MHz CPU (overclock!)"
	default n

config	RK_CPU_1800_VOLT
	depends on RK_CPU_1800
	int "1800 MHz CPU voltage (mV)"
	default "1375"

config	RK_CPU_1896
	bool "1896 MHz CPU (overclock!)"
	default n

config	RK_CPU_1896_VOLT
	depends on RK_CPU_1896
	int "1896 MHz CPU voltage (mV)"
	default "1375"

config	RK_CPU_1920
	bool "1920 MHz CPU (overclock!)"
	select RK_PWM_VOLT_MAX_1450
	default n

config	RK_CPU_1920_VOLT
	depends on RK_CPU_1920
	int "1920 MHz CPU voltage (mV)"
	default "1400"

config	RK_CPU_2016
	bool "2016 MHz CPU (overclock!)"
	select RK_PWM_VOLT_MAX_1450
	default n

config	RK_CPU_2016_VOLT
	depends on RK_CPU_2016
	int "2016 MHz CPU voltage (mV)"
	default "1450"

endmenu


menu	"GPU Frequency Scaling"

config	RK_GPU_133
	bool "133 MHz GPU"
	default y

config	RK_GPU_133_VOLT
	depends on RK_GPU_133
	int "133 MHz GPU voltage (mV)"
	default "975"

config	RK_GPU_200
	bool "200 MHz GPU"
	default y

config	RK_GPU_200_VOLT
	depends on RK_GPU_200
	int "200 MHz GPU voltage (mV)"
	default "1000"

config	RK_GPU_266
	bool "266 MHz GPU"
	default y

config	RK_GPU_266_VOLT
	depends on RK_GPU_266
	int "266 MHz GPU voltage (mV)"
	default "1025"

config	RK_GPU_300
	bool "300 MHz GPU"
	default y

config	RK_GPU_300_VOLT
	depends on RK_GPU_300
	int "300 MHz GPU voltage (mV)"
	default "1050"

config	RK_GPU_400
	bool "400 MHz GPU"
	default y

config	RK_GPU_400_VOLT
	depends on RK_GPU_400
	int "400 MHz GPU voltage (mV)"
	default "1100"

config	RK_GPU_600
	bool "600 MHz GPU"
	default y

config	RK_GPU_600_VOLT
	depends on RK_GPU_600
	int "600 MHz GPU voltage (mV)"
	default "1250"

config	RK_GPU_798
	bool "798 MHz GPU (overclock!)"
	default n

config	RK_GPU_798_VOLT
	depends on RK_GPU_798
	int "798 MHz GPU voltage (mV)"
	default "1325"

endmenu


menu	"DDR RAM Frequency Scaling"

config	RK_DDR_300
	bool "300 MHz DDR"
	default n

config	RK_DDR_300_VOLT
	depends on RK_DDR_300
	int "300 MHz DDR voltage (mV)"
	default "1100"

config	RK_DDR_360
	bool "360 MHz DDR"
	default n

config	RK_DDR_360_VOLT
	depends on RK_DDR_360
	int "360 MHz DDR voltage (mV)"
	default "1100"

config	RK_DDR_400
	bool "400 MHz DDR"
	default y

config	RK_DDR_400_VOLT
	depends on RK_DDR_400
	int "400 MHz DDR voltage (mV)"
	default "1100"

config	RK_DDR_500
	bool "500 MHz DDR (overclock!)"
	default n

config	RK_DDR_500_VOLT
	depends on RK_DDR_500
	int "500 MHz DDR voltage (mV)"
	default "1100"

config	RK_DDR_536
	bool "536 MHz DDR (overclock!)"
	default n

config	RK_DDR_536_VOLT
	depends on RK_DDR_536
	int "536 MHz DDR voltage (mV)"
	default "1100"

config	RK_DDR_600
	bool "600 MHz DDR (overclock!)"
	default n

config	RK_DDR_600_VOLT
	depends on RK_DDR_600
	int "600 MHz DDR voltage (mV)"
	default "1100"

config	RK_DDR_640
	bool "640 MHz DDR (overclock!)"
	default n

config	RK_DDR_640_VOLT
	depends on RK_DDR_640
	int "640 MHz DDR voltage (mV)"
	default "1100"

config	RK_DDR_667
	bool "667 MHz DDR (overclock!)"
	default n

config	RK_DDR_667_VOLT
	depends on RK_DDR_667
	int "667 MHz DDR voltage (mV)"
	default "1100"

config	RK_DDR_672
	bool "672 MHz DDR (overclock!)"
	default n

config	RK_DDR_672_VOLT
	depends on RK_DDR_672
	int "672 MHz DDR voltage (mV)"
	default "1100"

config	RK_DDR_700
	bool "700 MHz DDR (overclock!)"
	default n

config	RK_DDR_700_VOLT
	depends on RK_DDR_700
	int "700 MHz DDR voltage (mV)"
	default "1200"

config	RK_DDR_720
	bool "720 MHz DDR (overclock!)"
	default n

config	RK_DDR_720_VOLT
	depends on RK_DDR_720
	int "720 MHz DDR voltage (mV)"
	default "1200"

config	RK_DDR_768
	bool "768 MHz DDR (overclock!)"
	default n

config	RK_DDR_768_VOLT
	depends on RK_DDR_768
	int "768 MHz DDR voltage (mV)"
	default "1200"
	
config	RK_DDR_800
	bool "800 MHz DDR (overclock!)"
	default n

config	RK_DDR_800_VOLT
	depends on RK_DDR_800
	int "800 MHz DDR voltage (mV)"
	default "1250"

endmenu


endmenu
```
